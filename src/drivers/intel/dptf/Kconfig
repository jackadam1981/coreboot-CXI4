## src/drivers/intel/dptf/Kconfig
```kconfig
## SPDX-License-Identifier: GPL-2.0-only

config DRIVERS_INTEL_DPTF
	bool
	depends on HAVE_ACPI_TABLES
	default n
	help
	   When enabled, entries in the devicetree are used to generate
	   Intel DPTF Tables at runtime in the SSDT.

config HAVE_DPTF_EISA_HID
	bool

config DPTF_USE_EISA_HID
	bool
	depends on DRIVERS_INTEL_DPTF
	default y if HAVE_DPTF_EISA_HID
	default n
	help
	  Prior to Tiger Lake, all DPTF devices used 7-character EISA
	  IDs. If selected, the 7-character _HIDs will be emitted,
	  otherwise, it will use the "new" style, which are regular
	  8-character _HIDs.

config DRIVERS_INTEL_DPTF_SUPPORTS_TPCH
	def_bool n
	depends on HAVE_ACPI_TABLES && PMC_IPC_ACPI_INTERFACE
	help
	  When enabled, chip driver/intel/dptf will publish information to the
	  SSDT for the TPCH device.

config DRIVERS_INTEL_DPTF_SUPPORTS_TPWR
	def_bool n
	depends on DRIVERS_INTEL_DPTF
	help
	  When enabled, chip driver/intel/dptf will publish information to the
	  SSDT for TPWR device.

config DRIVERS_INTEL_DPTF_SUPPORTS_TBAT
	def_bool n
	depends on DRIVERS_INTEL_DPTF
	help
	  When enabled, chip driver/intel/dptf will publish information to the
	  SSDT for TBAT device.

config DRIVERS_INTEL_DPTF_DISABLE_ACTIVE_FAN
	bool "Disable DPTF Active Policy (fan control)"
	default n
	depends on DRIVERS_INTEL_DPTF
	help
	  When enabled, DPTF Active Policy (fan control) is disabled in ACPI.
	  Use this for boards that run EC auto fan mode (e.g. Windows/Generic
	  Linux) where DPTF would otherwise override EC with manual PWM commands.
	  Passive (CPU throttle), Critical (shutdown), Power Limits and Charger
	  controls remain enabled.
```
